## config/west.yml
```yaml
manifest:
  remotes:
    - name: zmkfirmware
      url-base: https://github.com/zmkfirmware
    - name: AlaaSaadAbdo
      url-base: https://github.com/AlaaSaadAbdo
    - name: mjmjm0101
      url-base: https://github.com/mjmjm0101
  projects:
    - name: zmk-pmw3610-driver
      remote: AlaaSaadAbdo
      revision: 3692d7563ea6ff3d6e9093e0286e88aedbf5ecfd # pinning to the right commit just in case.
    - name: zmk
      remote: zmkfirmware
      revision: v0.3.0
      import: app/west.yml
    - name: zmk-input-processor-scroll-inertia
      remote: mjmjm0101
      revision: main
  self:
    path: config
```
