/*
 * Copyright (c) 2020 Pete Johanson
 *
 * SPDX-License-Identifier: MIT
 */
 #include <dt-bindings/zmk/matrix-transform.h>
 
/ {
	chosen {
		zmk,kscan = &kscan0;
		zmk,matrix_transform = &default_transform;
	};
		
	default_transform: keymap_transform_0 {
	compatible = "zmk,matrix-transform";
        columns = <8>;
        rows = <1>;
		map = <
                RC(0,0) RC(0,1) 
              >;
	};	
	
	kscan0: kscan {
		compatible = "zmk,kscan-gpio-direct";
		label = "KSCAN";
	};
	
};


&kscan0 {
    input-gpios=
          <&xiao_d 6 (GPIO_ACTIVE_LOW | GPIO_PULL_UP)>//D7
        , <&xiao_d 7 (GPIO_ACTIVE_LOW | GPIO_PULL_UP)>//C6
 	    ;
};
      