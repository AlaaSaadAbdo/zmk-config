## config/boards/shields/copypasta/Kconfig.defconfig
```kconfig
# Copyright (c) 2021 The ZMK Contributors
# SPDX-License-Identifier: MIT

if SHIELD_COPYPASTA

config ZMK_KEYBOARD_NAME
    default "Copypasta"

endif
```

## config/boards/shields/copypasta/Kconfig.shield
```kconfig
# Copyright (c) 2021 The ZMK Contributors
# SPDX-License-Identifier: MIT

config SHIELD_COPYPASTA
    def_bool $(shields_list_contains,copypasta)
```

## config/boards/shields/duck/Kconfig.defconfig
```kconfig
# Copyright (c) 2022 The ZMK Contributors
# SPDX-License-Identifier: MIT

if SHIELD_DUCK_LEFT

config ZMK_KEYBOARD_NAME
	default "duck"

config ZMK_SPLIT_BLE_ROLE_CENTRAL
	default y

endif

if SHIELD_DUCK_LEFT || SHIELD_DUCK_RIGHT

config ZMK_SPLIT
	default y

endif
```

## config/boards/shields/duck/Kconfig.shield
```kconfig
# Copyright (c) 2022 The ZMK Contributors
# SPDX-License-Identifier: MIT

config SHIELD_DUCK_LEFT
	def_bool $(shields_list_contains,duck_left)

config SHIELD_DUCK_RIGHT
	def_bool $(shields_list_contains,duck_right)
```

## config/boards/shields/ducks/Kconfig.defconfig
```kconfig
# Copyright (c) 2022 The ZMK Contributors
# SPDX-License-Identifier: MIT

if SHIELD_DUCKS_LEFT

config ZMK_KEYBOARD_NAME
	default "ducks"

config ZMK_SPLIT_BLE_ROLE_CENTRAL
	default y

endif

if SHIELD_DUCKS_LEFT || SHIELD_DUCKS_RIGHT

config ZMK_SPLIT
	default y

endif
```

## config/boards/shields/ducks/Kconfig.shield
```kconfig
# Copyright (c) 2022 The ZMK Contributors
# SPDX-License-Identifier: MIT

config SHIELD_DUCKS_LEFT
	def_bool $(shields_list_contains,ducks_left)

config SHIELD_DUCKS_RIGHT
	def_bool $(shields_list_contains,ducks_right)
```

## config/boards/shields/ghazal/Kconfig.shield
```kconfig
# Copyright (c) 2021 The ZMK Contributors
# SPDX-License-Identifier: MIT

config SHIELD_GHAZAL
    def_bool $(shields_list_contains,ghazal)
```

## config/boards/shields/keywell/Kconfig.defconfig
```kconfig
# Copyright (c) 2022 The ZMK Contributors
# SPDX-License-Identifier: MIT

if SHIELD_KEYWELL_LEFT

config ZMK_KEYBOARD_NAME
	default "Keywell"

config ZMK_SPLIT_BLE_ROLE_CENTRAL
	default y

endif

if SHIELD_KEYWELL_LEFT || SHIELD_KEYWELL_RIGHT

config ZMK_SPLIT
	default y

endif
```

## config/boards/shields/keywell/Kconfig.shield
```kconfig
# Copyright (c) 2022 The ZMK Contributors
# SPDX-License-Identifier: MIT

config SHIELD_KEYWELL_LEFT
	def_bool $(shields_list_contains,keywell_left)

config SHIELD_KEYWELL_RIGHT
	def_bool $(shields_list_contains,keywell_right)
```

## config/boards/shields/konafa/Kconfig.defconfig
```kconfig
# Copyright (c) 2022 The ZMK Contributors
# SPDX-License-Identifier: MIT

if SHIELD_KONAFA_LEFT

config ZMK_KEYBOARD_NAME
	default "Konafa"

config ZMK_SPLIT_BLE_ROLE_CENTRAL
	default y

endif

if SHIELD_KONAFA_LEFT || SHIELD_KONAFA_RIGHT

config ZMK_SPLIT
	default y

endif
```

## config/boards/shields/konafa/Kconfig.shield
```kconfig
# Copyright (c) 2022 The ZMK Contributors
# SPDX-License-Identifier: MIT

config SHIELD_KONAFA_LEFT
	def_bool $(shields_list_contains,konafa_left)

config SHIELD_KONAFA_RIGHT
	def_bool $(shields_list_contains,konafa_right)
```

## config/boards/shields/rommana/Kconfig.defconfig
```kconfig
# Copyright (c) 2022 The ZMK Contributors
# SPDX-License-Identifier: MIT

if SHIELD_ROMMANA_LEFT

config ZMK_KEYBOARD_NAME
	default "Rommana"

config ZMK_SPLIT_BLE_ROLE_CENTRAL
	default y

endif

if SHIELD_ROMMANA_LEFT || SHIELD_ROMMANA_RIGHT

config ZMK_SPLIT
	default y

endif
```

## config/boards/shields/wasfoora/Kconfig.defconfig
```kconfig
# Copyright (c) 2021 The ZMK Contributors
# SPDX-License-Identifier: MIT

if SHIELD_WASFOORA

config ZMK_KEYBOARD_NAME
    default "Wasfoora"

endif
```

## config/boards/shields/wasfoora/Kconfig.shield
```kconfig
# Copyright (c) 2021 The ZMK Contributors
# SPDX-License-Identifier: MIT

config SHIELD_WASFOORA
    def_bool $(shields_list_contains,wasfoora)
```

## config/boards/shields/wizza/Kconfig.defconfig
```kconfig
# Copyright (c) 2022 The ZMK Contributors
# SPDX-License-Identifier: MIT

if SHIELD_WIZZA_LEFT

config ZMK_KEYBOARD_NAME
	default "Wizza"

config ZMK_SPLIT_BLE_ROLE_CENTRAL
	default y

endif

if SHIELD_WIZZA_LEFT || SHIELD_WIZZA_RIGHT

config ZMK_SPLIT
	default y

endif
```

## config/boards/shields/wizza/Kconfig.shield
```kconfig
# Copyright (c) 2022 The ZMK Contributors
# SPDX-License-Identifier: MIT

config SHIELD_WIZZA_LEFT
	def_bool $(shields_list_contains,wizza_left)

config SHIELD_WIZZA_RIGHT
	def_bool $(shields_list_contains,wizza_right)
```

## config/boards/shields/wizzaV2/Kconfig.defconfig
```kconfig
# Copyright (c) 2022 The ZMK Contributors
# SPDX-License-Identifier: MIT

if SHIELD_WIZZAV2_LEFT

config ZMK_KEYBOARD_NAME
	default "Wizzav2"

config ZMK_SPLIT_BLE_ROLE_CENTRAL
	default y

endif

if SHIELD_WIZZAV2_LEFT || SHIELD_WIZZAV2_RIGHT

config ZMK_SPLIT
	default y

endif
```

## config/boards/shields/wizzaV2/Kconfig.shield
```kconfig
# Copyright (c) 2022 The ZMK Contributors
# SPDX-License-Identifier: MIT

config SHIELD_WIZZAV2_LEFT
	def_bool $(shields_list_contains,wizzav2_left)

config SHIELD_WIZZAV2_RIGHT
	def_bool $(shields_list_contains,wizzav2_right)
```

## config/boards/shields/wizzades/Kconfig.defconfig
```kconfig
# Copyright (c) 2022 The ZMK Contributors
# SPDX-License-Identifier: MIT

if SHIELD_WIZZADES_LEFT

config ZMK_KEYBOARD_NAME
	default "WizzaDes"

config ZMK_SPLIT_BLE_ROLE_CENTRAL
	default y

endif

if SHIELD_WIZZADES_LEFT || SHIELD_WIZZADES_RIGHT

config ZMK_SPLIT
	default y

endif
```

## config/boards/shields/wizzades/Kconfig.shield
```kconfig
# Copyright (c) 2022 The ZMK Contributors
# SPDX-License-Identifier: MIT

config SHIELD_WIZZADES_LEFT
	def_bool $(shields_list_contains,wizzades_left)

config SHIELD_WIZZADES_RIGHT
	def_bool $(shields_list_contains,wizzades_right)
```
