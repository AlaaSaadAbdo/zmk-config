## config/boards/shields/32w_ducks/Kconfig.defconfig
```kconfig
# Copyright (c) 2022 The ZMK Contributors
# SPDX-License-Identifier: MIT

if SHIELD_RAE_DUX_LEFT

config ZMK_KEYBOARD_NAME
	default "32w-ducks"

config ZMK_SPLIT_BLE_ROLE_CENTRAL
	default y

endif

if SHIELD_RAE_DUX_LEFT || SHIELD_RAE_DUX_RIGHT

config ZMK_SPLIT
	default y

endif
```

## config/boards/shields/32w_ducks/Kconfig.shield
```kconfig
# Copyright (c) 2022 The ZMK Contributors
# SPDX-License-Identifier: MIT

config SHIELD_32W_DUCKS_LEFT
	def_bool $(shields_list_contains,32w_ducks_left)

config SHIELD_32W_DUCKS_RIGHT
	def_bool $(shields_list_contains,32w_ducks_right)
```

## config/boards/shields/34w_ducks/Kconfig.defconfig
```kconfig
# Copyright (c) 2022 The ZMK Contributors
# SPDX-License-Identifier: MIT

if SHIELD_34W_DUCKS_LEFT

config ZMK_KEYBOARD_NAME
	default "34w-ducks"

config ZMK_SPLIT_BLE_ROLE_CENTRAL
	default y

endif

if SHIELD_34W_DUCKS_LEFT || SHIELD_34W_DUCKS_RIGHT

config ZMK_SPLIT
	default y

endif
```

## config/boards/shields/asfoora/Kconfig.defconfig
```kconfig
# Copyright (c) 2021 The ZMK Contributors
# SPDX-License-Identifier: MIT

if SHIELD_ASFOORA

config ZMK_KEYBOARD_NAME
    default "Asfoora"

endif
```

## config/boards/shields/asfoora/Kconfig.shield
```kconfig
# Copyright (c) 2021 The ZMK Contributors
# SPDX-License-Identifier: MIT

config SHIELD_ASFOORA
    def_bool $(shields_list_contains,asfoora)
```

## config/boards/shields/basbousa/Kconfig.defconfig
```kconfig
# Copyright (c) 2022 The ZMK Contributors
# SPDX-License-Identifier: MIT

if SHIELD_BASBOUSA_LEFT

config ZMK_KEYBOARD_NAME
	default "Basbousa"

config ZMK_SPLIT_BLE_ROLE_CENTRAL
	default y

endif

if SHIELD_BASBOUSA_LEFT || SHIELD_BASBOUSA_RIGHT

config ZMK_SPLIT
	default y

endif
```

## config/boards/shields/basbousa/Kconfig.shield
```kconfig
# Copyright (c) 2022 The ZMK Contributors
# SPDX-License-Identifier: MIT

config SHIELD_BASBOUSA_LEFT
	def_bool $(shields_list_contains,basbousa_left)

config SHIELD_BASBOUSA_RIGHT
	def_bool $(shields_list_contains,basbousa_right)
```

## config/boards/shields/batreeq/Kconfig.defconfig
```kconfig
# Copyright (c) 2021 The ZMK Contributors
# SPDX-License-Identifier: MIT

if SHIELD_BATREEQ

config ZMK_KEYBOARD_NAME
    default "Batreeq"

endif
```

## config/boards/shields/batreeq/Kconfig.shield
```kconfig
# Copyright (c) 2021 The ZMK Contributors
# SPDX-License-Identifier: MIT

config SHIELD_BATREEQ
    def_bool $(shields_list_contains,batreeq)
```

## config/boards/shields/batta/Kconfig.defconfig
```kconfig
# Copyright (c) 2022 The ZMK Contributors
# SPDX-License-Identifier: MIT

if SHIELD_BATTA_LEFT

config ZMK_KEYBOARD_NAME
	default "Batta"

config ZMK_SPLIT_BLE_ROLE_CENTRAL
	default y

endif

if SHIELD_BATTA_LEFT || SHIELD_BATTA_RIGHT

config ZMK_SPLIT
	default y

endif
```

## config/boards/shields/batta/Kconfig.shield
```kconfig
# Copyright (c) 2022 The ZMK Contributors
# SPDX-License-Identifier: MIT

config SHIELD_BATTA_LEFT
	def_bool $(shields_list_contains,batta_left)

config SHIELD_BATTA_RIGHT
	def_bool $(shields_list_contains,batta_right)
```

## config/boards/shields/battamini/Kconfig.defconfig
```kconfig
# Copyright (c) 2022 The ZMK Contributors
# SPDX-License-Identifier: MIT

if SHIELD_BATTAMINI_LEFT

config ZMK_KEYBOARD_NAME
	default "battamini"

config ZMK_SPLIT_BLE_ROLE_CENTRAL
	default y

endif

if SHIELD_BATTAMINI_LEFT || SHIELD_BATTAMINI_RIGHT

config ZMK_SPLIT
	default y

endif
```

## config/boards/shields/battamini/Kconfig.shield
```kconfig
# Copyright (c) 2022 The ZMK Contributors
# SPDX-License-Identifier: MIT

config SHIELD_BATTAMINI_LEFT
	def_bool $(shields_list_contains,battamini_left)

config SHIELD_BATTAMINI_RIGHT
	def_bool $(shields_list_contains,battamini_right)
```

## config/boards/shields/battoota/Kconfig.defconfig
```kconfig
# Copyright (c) 2022 The ZMK Contributors
# SPDX-License-Identifier: MIT

if SHIELD_BATTOOTA_LEFT

config ZMK_KEYBOARD_NAME
	default "Battoota"

config ZMK_SPLIT_BLE_ROLE_CENTRAL
	default y

endif

if SHIELD_BATTOOTA_LEFT || SHIELD_BATTOOTA_RIGHT

config ZMK_SPLIT
	default y

endif
```

## config/boards/shields/battoota/Kconfig.shield
```kconfig
# Copyright (c) 2022 The ZMK Contributors
# SPDX-License-Identifier: MIT

config SHIELD_BATTOOTA_LEFT
	def_bool $(shields_list_contains,battoota_left)

config SHIELD_BATTOOTA_RIGHT
	def_bool $(shields_list_contains,battoota_right)
```

## config/boards/shields/battoota3/Kconfig.defconfig
```kconfig
# Copyright (c) 2022 The ZMK Contributors
# SPDX-License-Identifier: MIT

if SHIELD_BATTOOTA3_LEFT

config ZMK_KEYBOARD_NAME
	default "Battoota3"

config ZMK_SPLIT_BLE_ROLE_CENTRAL
	default y

endif

if SHIELD_BATTOOTA3_LEFT || SHIELD_BATTOOTA3_RIGHT

config ZMK_SPLIT
	default y

endif
```

## config/boards/shields/battoota3/Kconfig.shield
```kconfig
# Copyright (c) 2022 The ZMK Contributors
# SPDX-License-Identifier: MIT

config SHIELD_BATTOOTA3_LEFT
	def_bool $(shields_list_contains,battoota3_left)

config SHIELD_BATTOOTA3_RIGHT
	def_bool $(shields_list_contains,battoota3_right)
```

## config/boards/shields/battootamin/Kconfig.defconfig
```kconfig
# Copyright (c) 2022 The ZMK Contributors
# SPDX-License-Identifier: MIT

if SHIELD_BATTOOTAMIN_LEFT

config ZMK_KEYBOARD_NAME
	default "Battootamin"

config ZMK_SPLIT_BLE_ROLE_CENTRAL
	default y

endif

if SHIELD_BATTOOTAMIN_LEFT || SHIELD_BATTOOTAMIN_RIGHT

config ZMK_SPLIT
	default y

endif
```

## config/boards/shields/battootamin/Kconfig.shield
```kconfig
# Copyright (c) 2022 The ZMK Contributors
# SPDX-License-Identifier: MIT

config SHIELD_BATTOOTAMIN_LEFT
	def_bool $(shields_list_contains,battootamin_left)

config SHIELD_BATTOOTAMIN_RIGHT
	def_bool $(shields_list_contains,battootamin_right)
```

## config/boards/shields/battootaone/Kconfig.defconfig
```kconfig
# Copyright (c) 2022 The ZMK Contributors
# SPDX-License-Identifier: MIT

if SHIELD_BATTOOTAONE_LEFT

config ZMK_KEYBOARD_NAME
	default "Battootaone"

config ZMK_SPLIT_BLE_ROLE_CENTRAL
	default y

endif

if SHIELD_BATTOOTAONE_LEFT || SHIELD_BATTOOTAONE_RIGHT

config ZMK_SPLIT
	default y

endif
```

## config/boards/shields/battootaone/Kconfig.shield
```kconfig
# Copyright (c) 2022 The ZMK Contributors
# SPDX-License-Identifier: MIT

config SHIELD_BATTOOTAONE_LEFT
	def_bool $(shields_list_contains,battootaone_left)

config SHIELD_BATTOOTAONE_RIGHT
	def_bool $(shields_list_contains,battootaone_right)
```

## config/boards/shields/battootas/Kconfig.defconfig
```kconfig
# Copyright (c) 2022 The ZMK Contributors
# SPDX-License-Identifier: MIT

if SHIELD_BATTOOTAS_LEFT

config ZMK_KEYBOARD_NAME
	default "Battootas"

config ZMK_SPLIT_BLE_ROLE_CENTRAL
	default y

endif

if SHIELD_BATTOOTAS_LEFT || SHIELD_BATTOOTAS_RIGHT

config ZMK_SPLIT
	default y

endif
```

## config/boards/shields/battootas/Kconfig.shield
```kconfig
# Copyright (c) 2022 The ZMK Contributors
# SPDX-License-Identifier: MIT

config SHIELD_BATTOOTAS_LEFT
	def_bool $(shields_list_contains,battootas_left)

config SHIELD_BATTOOTAS_RIGHT
	def_bool $(shields_list_contains,battootas_right)
```

## config/boards/shields/battootasmall/Kconfig.defconfig
```kconfig
# Copyright (c) 2022 The ZMK Contributors
# SPDX-License-Identifier: MIT

if SHIELD_BATTOOTASMALL_LEFT

config ZMK_KEYBOARD_NAME
	default "Battootasmall"

config ZMK_SPLIT_BLE_ROLE_CENTRAL
	default y

endif

if SHIELD_BATTOOTASMALL_LEFT || SHIELD_BATTOOTASMALL_RIGHT

config ZMK_SPLIT
	default y

endif
```

## config/boards/shields/battootasmall/Kconfig.shield
```kconfig
# Copyright (c) 2022 The ZMK Contributors
# SPDX-License-Identifier: MIT

config SHIELD_BATTOOTASMALL_LEFT
	def_bool $(shields_list_contains,battootasmall_left)

config SHIELD_BATTOOTASMALL_RIGHT
	def_bool $(shields_list_contains,battootasmall_right)
```
